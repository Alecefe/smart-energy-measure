## main/Kconfig.projbuild
```kconfig
menu "Example Configuration"

    choice EXAMPLE_IP_MODE
        prompt "IP Version"
        help
            Example can use either IPV4 or IPV6.

        config EXAMPLE_IPV4
            bool "IPV4"

        config EXAMPLE_IPV6
            bool "IPV6"

    endchoice

    config EXAMPLE_IPV4_ADDR
        string "IPV4 Address"
        default "192.168.0.165"
        depends on EXAMPLE_IPV4
        help
            The example will connect to this IPV4 address.

    config EXAMPLE_IPV6_ADDR
        string "IPV6 Address"
        default "FE80::30AD:E57B:C212:68AD"
        depends on EXAMPLE_IPV6
        help
            The example will connect to this IPV6 address.

    config EXAMPLE_PORT
        int "Port"
        range 0 65535
        default 3333
        help
            The remote port to which the client example will connect to.


    config EXAMPLE_MDNS_HOST_NAME
        string "mDNS Host Name"
        default "esp-home"
        help
            Specify the domain name used in the mDNS service.
            Note that webpage also take it as a part of URL where it will send GET/POST requests to.

    choice EXAMPLE_WEB_DEPLOY_MODE
        prompt "Website deploy mode"
        default EXAMPLE_WEB_DEPLOY_SEMIHOST
        help
            Select website deploy mode.
            You can deploy website to host, and ESP32 will retrieve them in a semihost way (JTAG is needed).
            You can deploy website to SD card or SPI flash, and ESP32 will retrieve them via SDIO/SPI interface.
            Detailed operation steps are listed in the example README file.
        config EXAMPLE_WEB_DEPLOY_SEMIHOST
            bool "Deploy website to host (JTAG is needed)"
            help
                Deploy website to host.
                It is recommended to choose this mode during developing.
        config EXAMPLE_WEB_DEPLOY_SD
            bool "Deploy website to SD card"
            help
                Deploy website to SD card.
                Choose this production mode if the size of website is too large (bigger than 2MB).
        config EXAMPLE_WEB_DEPLOY_SF
            bool "Deploy website to SPI Nor Flash"
            help
                Deploy website to SPI Nor Flash.
                Choose this production mode if the size of website is small (less than 2MB).
    endchoice

    if EXAMPLE_WEB_DEPLOY_SEMIHOST
        config EXAMPLE_HOST_PATH_TO_MOUNT
            string "Host path to mount (e.g. absolute path to web dist directory)"
            default "PATH-TO-WEB-DIST_DIR"
            help
                When using semihost in ESP32, you should specify the host path which will be mounted to VFS.
                Note that only absolute path is acceptable.
    endif

    config EXAMPLE_WEB_MOUNT_POINT
        string "Website mount point in VFS"
        default "/www"
        help
            Specify the mount point in VFS.

endmenu
```
